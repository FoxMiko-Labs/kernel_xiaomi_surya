## drivers/power/supply/maxim/Kconfig
```kconfig
config BATT_VERIFY_BY_DS28E16
	bool
	prompt "Support ds28e16 as encryption IC."
	default n
	help
		It needs a onewire physical controller to work.
```
